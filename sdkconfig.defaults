## sdkconfig.defaults
```kconfig
# M5Stack Core2（ESP32 / フラッシュ 16MB / PSRAM 8MB）
CONFIG_IDF_TARGET="esp32"
CONFIG_ESPTOOLPY_FLASHSIZE_16MB=y
CONFIG_ESPTOOLPY_FLASHFREQ_80M=y
CONFIG_PARTITION_TABLE_CUSTOM=y
CONFIG_PARTITION_TABLE_CUSTOM_FILENAME="partitions.csv"

CONFIG_ESP_DEFAULT_CPU_FREQ_MHZ_240=y
CONFIG_FREERTOS_HZ=1000
CONFIG_ESP_MAIN_TASK_STACK_SIZE=8192
CONFIG_COMPILER_OPTIMIZATION_PERF=y

# PSRAM。4KB 以下の確保は内部 RAM から
CONFIG_SPIRAM=y
CONFIG_SPIRAM_USE_MALLOC=y
CONFIG_SPIRAM_MALLOC_ALWAYSINTERNAL=4096
CONFIG_SPIRAM_MALLOC_RESERVE_INTERNAL=65536

# Bluetooth: Classic のみ（BLE は使わない）
CONFIG_BT_ENABLED=y
CONFIG_BT_BLUEDROID_ENABLED=y
CONFIG_BT_CLASSIC_ENABLED=y
CONFIG_BT_BLE_ENABLED=n
CONFIG_BTDM_CTRL_MODE_BR_EDR_ONLY=y
CONFIG_BTDM_CTRL_BR_EDR_MAX_ACL_CONN=2
CONFIG_BTDM_CTRL_BR_EDR_MAX_SYNC_CONN=1
CONFIG_BT_ALLOCATION_FROM_SPIRAM_FIRST=y

# HFP Audio Gateway。音声をソフトで扱うため HCI データパス（ホスト側・コントローラー側の両方）
CONFIG_BT_HFP_ENABLE=y
CONFIG_BT_HFP_AG_ENABLE=y
CONFIG_BT_HFP_AUDIO_DATA_PATH_HCI=y
CONFIG_BTDM_CTRL_BR_EDR_SCO_DATA_PATH_HCI=y
CONFIG_BT_HFP_WBS_ENABLE=y

# SD カード（FAT32。長いファイル名を使う）
CONFIG_FATFS_LFN_HEAP=y
CONFIG_FATFS_MAX_LFN=255

# IRAM が足りないので、割り込み処理から呼ばない標準ライブラリーの一部はフラッシュに置く
# （PSRAM のキャッシュ対策で既定では IRAM に置かれる）
CONFIG_SPIRAM_CACHE_LIBMATH_IN_IRAM=n
CONFIG_SPIRAM_CACHE_LIBRAND_IN_IRAM=n
CONFIG_SPIRAM_CACHE_LIBENV_IN_IRAM=n
```
